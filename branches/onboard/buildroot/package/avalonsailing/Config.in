## branches/onboard/buildroot/package/avalonsailing/Config.in
```kconfig
config BR2_PACKAGE_AVALONSAILING
	bool "avalonsailing"
	depends on BR2_INSTALL_LIBSTDCPP
	help
          Code to sail your boat across the ocean.
          http://code.google.com/p/avalonsailing

comment "iperf requires a toolchain with C++ support enabled"
	depends on !BR2_INSTALL_LIBSTDCPP
```
